## CMakeLists.txt
```
#
# Copyright (c) 2019 Nordic Semiconductor
#
# SPDX-License-Identifier: LicenseRef-BSD-5-Clause-Nordic
#

cmake_minimum_required(VERSION 3.8.2)

include($ENV{ZEPHYR_BASE}/cmake/app/boilerplate.cmake NO_POLICY_SCOPE)
project(http_app_flash_write)

target_sources(app PRIVATE src/main.c)
```

## Kconfig
```
#
# Copyright (c) 2019 Nordic Semiconductor ASA
#
# SPDX-License-Identifier: LicenseRef-BSD-5-Clause-Nordic
#

menu "nRF91 HTTP Client Flash Write example"

config FLASH_OFFSET
	hex "Default start address for flash write in this sample"
	default 0x62000

config HOST
	string "Host name"

config RESOURCE
	string "The file to download"

endmenu

menu "Zephyr Kernel"
source "$ZEPHYR_BASE/Kconfig.zephyr"
endmenu
```

## prj.conf
```kconfig
# General config
CONFIG_NEWLIB_LIBC=y
CONFIG_TEST_RANDOM_GENERATOR=y
CONFIG_ASSERT=y
CONFIG_REBOOT=y

# Trusted execution
CONFIG_TRUSTED_EXECUTION_NONSECURE=y

# Network
CONFIG_NETWORKING=y
CONFIG_NET_SOCKETS=y
CONFIG_NET_SOCKETS_OFFLOAD=y

# LTE link control
CONFIG_LTE_LINK_CONTROL=y
CONFIG_LTE_AUTO_INIT_AND_CONNECT=y

# BSD library
CONFIG_BSD_LIBRARY=y

# Library for buttons and LEDs
CONFIG_DK_LIBRARY=y
CONFIG_DK_LIBRARY_INVERT_LEDS=n

# Console
CONFIG_CONSOLE_SUBSYS=y
CONFIG_CONSOLE_HANDLER=y
CONFIG_CONSOLE_GETCHAR=y

# Main thread
CONFIG_MAIN_THREAD_PRIORITY=7

# Heap and stacks
CONFIG_HEAP_MEM_POOL_SIZE=16384
CONFIG_MAIN_STACK_SIZE=8192
CONFIG_MPU_STACK_GUARD=y

CONFIG_DEBUG=y

# Enable HTTP and HTTP DFU libs
CONFIG_NRF_HTTP_CLIENT=y
CONFIG_NRF_HTTP_DFU_CLIENT=y
CONFIG_NRF_DFU_HTTP_MAX_RESPONSE_SIZE=2048

# Enable Log, with debug messages and in place processing
CONFIG_LOG=y
CONFIG_LOG_DEFAULT_LEVEL=3
CONFIG_LOG_IMMEDIATE=y
CONFIG_LOG_PRINTK=y

CONFIG_FLASH=y
CONFIG_FLASH_PAGE_LAYOUT=y
CONFIG_MPU_ALLOW_FLASH_WRITE=y

# Default host and resouce (file) for this example.
# Please change to your own file
CONFIG_HOST="s3.amazonaws.com"
CONFIG_RESOURCE="/nordic-firmware-files/f81197c5-0353-4ac2-a961-3b2ce867329d"
```

## src/main.c
```c
/*
 * Copyright (c) 2019 Nordic Semiconductor ASA
 *
 * SPDX-License-Identifier: LicenseRef-BSD-5-Clause-Nordic
 */
#include <stdint.h>
#include <zephyr.h>
#include <flash.h>
#include <bsd.h>
#include <nrf_socket.h>
#include <dfu_client.h>
#include <logging/log.h>

LOG_MODULE_REGISTER(main);

static struct device		*m_flash_dev;

static int app_dfu_client_event_handler(struct dfu_client_object *const dfu,
			enum dfu_client_evt event, u32_t status);


static struct dfu_client_object dfu = {
	.host = CONFIG_HOST,
	.resource = CONFIG_RESOURCE,
	.callback = app_dfu_client_event_handler
};


/**@brief Recoverable BSD library error. */
void bsd_recoverable_error_handler(uint32_t err)
{
	LOG_ERR("%s = %lu\n", __func__, err);

	/* Read the fault register for details. */
	volatile uint32_t fault_reason = *((volatile uint32_t *)0x4002A614);

	__ASSERT(false, "%s, reason %lu, reset application\n",
					__func__, fault_reason);
}

/**@brief Irrecoverable BSD library error. */
void bsd_irrecoverable_error_handler(uint32_t err)
{
	LOG_ERR("%s = %lu\n", __func__, err);

	/* Read the fault register for details. */
	volatile uint32_t fault_reason = *((volatile uint32_t *)0x4002A614);

	__ASSERT(false, "%s, reason %lu, reset application\n",
					 __func__, fault_reason);
}


/**@brief Initialize application. */
static void app_init(void)
{
	m_flash_dev = device_get_binding(DT_FLASH_DEV_NAME);

	__ASSERT(m_flash_dev != 0, "Nordic nRF flash driver was not found!\n");

	int retval = dfu_client_init(&dfu);

	__ASSERT(retval == 0, "dfu_client_init() failed, err %d", retval);
}


/**@brief Start transfer of the file. */
static void app_transfer_start(void)
{
	int retval = dfu_client_connect(&dfu);

	__ASSERT(retval == 0, "dfu_client_connect() failed, err %d", retval);

	retval = dfu_client_download(&dfu);
	__ASSERT(retval != -1, "dfu_client_download() failed, err %d", retval);
}


static int app_dfu_client_event_handler(struct dfu_client_object *const dfu,
					enum dfu_client_evt event, u32_t error)
{
	int err;

	switch (event) {
	case DFU_CLIENT_EVT_DOWNLOAD_FRAG: {
		static u32_t address = CONFIG_FLASH_OFFSET;

		/* Erase page(s) here: */

		err = flash_write(m_flash_dev, address, dfu->fragment,
							dfu->fragment_size);
		if (err != 0) {
			__ASSERT(false,
					"Flash write error %d at address %08x\n",
					err, address);
		}
		address += dfu->fragment_size;
		break;
	}

	case DFU_CLIENT_EVT_DOWNLOAD_DONE:
		LOG_INF("DFU DFU_CLIENT_EVT_DOWNLOAD_DONE");
		break;

	case DFU_CLIENT_EVT_ERROR: {
		LOG_ERR("DFU error");
		dfu_client_disconnect(dfu);
		__ASSERT(false, "Something went wrong, please restart "
						"the application\n");
		break;
	}
	default:
		break;
	}
	return 0;
}



int main(void)
{
	app_init();

	app_transfer_start();

	while (dfu.status != DFU_CLIENT_STATUS_DOWNLOAD_COMPLETE) {
		dfu_client_process(&dfu);
	}

	dfu_client_disconnect(&dfu);
	LOG_INF("Download complete. Nothing more to do.");
	while (true) {
	}

	return 0;
}
```
